## conf/layer.conf
```bitbake
# We have a conf and classes directory, add to BBPATH
BBPATH .= ":${LAYERDIR}"

# We have recipes-* directories, add to BBFILES
BBFILES += "${LAYERDIR}/recipes-*/*/*.bb \
            ${LAYERDIR}/recipes-*/*/*.bbappend"

BBFILE_COLLECTIONS += "meta-st-py3-ext"
BBFILE_PATTERN_meta-st-py3-ext = "^${LAYERDIR}/"
BBFILE_PRIORITY_meta-st-py3-ext = "7"

LAYERDEPENDS_meta-st-py3-ext = "stm-st-stm32mp"
LAYERVERSION_meta-st-py3-ext = "1"
LAYERSERIES_COMPAT_meta-st-py3-ext = "dunfell"

IMAGE_INSTALL_append = " \
    python3 \
    python3-pip \
    python3-dev \
    python3-pyserial \
    python3-core \
    python3-misc \   
    glib-2.0-dev \
    packagegroup-core-buildessential \
    git \
    libffi-dev \
"
```
